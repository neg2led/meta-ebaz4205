## conf/distro/ebaz4205-dist.conf
```bitbake
require conf/distro/poky.conf

DISTRO = "ebaz4205-dist"
DISTRO_NAME = "EBAZ4205 Distro"
DISTRO_VERSION = "1.1"

DISTRO_FEATURES_append = " systemd"
VIRTUAL-RUNTIME_init_manager = "systemd"
DISTRO_FEATURES_BACKFILL_CONSIDERED = "sysvinit"

PACKAGE_CLASSES = "package_ipk"

VIRTUAL-RUNTIME_dev_manager = "udev"

PREFERRED_PROVIDER_virtual/kernel := "linux-xlnx"
PREFERRED_VERSION_linux-xlnx := "5.4%"

#PREFERRED_PROVIDER_qemu-native := "qemu-xilinx-native"

#PREFERRED_RPROVIDER_nativesdk-qemu:= "nativesdk-qemu-xilinx"
```
